## sdkconfig.defaults
```kconfig
# Bluetooth configuration for ESP32-S3
CONFIG_BT_ENABLED=y
CONFIG_BT_BLUEDROID_ENABLED=y
CONFIG_BT_BLE_42_FEATURES_SUPPORTED=y
CONFIG_BT_BLE_RPA_SUPPORTED=y
CONFIG_BT_BLE_RPA_TIMEOUT=900

# Custom partition table (larger app partition for BT)
CONFIG_PARTITION_TABLE_CUSTOM=y
CONFIG_PARTITION_TABLE_CUSTOM_FILENAME="partitions.csv"
CONFIG_PARTITION_TABLE_FILENAME="partitions.csv"
```
